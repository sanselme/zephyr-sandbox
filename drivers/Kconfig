## drivers/Kconfig
```kconfig
# SPDX-License-Identifier: GPL-3.0
# Copyright (c) 2025 Schubert Anselme <schubert@anselm.es>

menu "Drivers"

rsource "blink/Kconfig"
rsource "sensor/Kconfig"

endmenu
```

## drivers/blink/Kconfig.gpio_led
```kconfig
# SPDX-License-Identifier: GPL-3.0
# Copyright (c) 2025 Schubert Anselme <schubert@anselm.es>

config BLINK_GPIO_LED
  bool "GPIO-controlled LED blink driver"
  default y
  depends on DT_HAS_BLINK_GPIO_LED_ENABLED
  select GPIO
  help
    Enable this option to use the GPIO-controlled LED blink driver. This
    demonstrates how to implement a driver for a custom driver class.
```

## drivers/sensor/Kconfig
```kconfig
# SPDX-License-Identifier: GPL-3.0
# Copyright (c) 2025 Schubert Anselme <schubert@anselm.es>

if SENSOR

rsource "sandbox_sensor/Kconfig"

endif
```

## drivers/sensor/example_sensor/Kconfig
```kconfig
# SPDX-License-Identifier: GPL-3.0
# Copyright (c) 2025 Schubert Anselme <schubert@anselm.es>

config EXAMPLE_SENSOR
  bool "Example Sensor"
  default y
  depends on DT_HAS_ZEPHYR_EXAMPLE_SENSOR_ENABLED
  select GPIO
  help
    Enable example sensor
```

## drivers/sensor/sandbox_sensor/Kconfig
```kconfig
# SPDX-License-Identifier: GPL-3.0
# Copyright (c) 2025 Schubert Anselme <schubert@anselm.es>

config SANDBOX_SENSOR
  bool "Sandbox Sensor"
  default y
  depends on DT_HAS_ZEPHYR_SANDBOX_SENSOR_ENABLED
  select GPIO
  help
    Enable example sensor
```

## dts/bindings/sensor/zephyr,sandbox-sensor.yaml
```yaml
# SPDX-License-Identifier: GPL-3.0
# Copyright (c) 2025 Schubert Anselme <schubert@anselm.es>

description: |
  A sandbox sensor that reads the GPIO level defined in input-gpios. The
  purpose of this sensor is to demonstrate how to create out-of-tree drivers.

  Example definition in devicetree:

    sandbox-sensor {
      compatible  = "zephyr,sandbox-sensor";
      input-gpios = <&gpio0 0 (GPIO_PULL_UP | GPIO_ACTIVE_LOW)>;
    };

compatible: "zephyr,sandbox-sensor"

include: base.yaml

properties:
  input-gpios:
    type: phandle-array
    required: true
    description: Input GPIO to be sensed.
```

## lib/hello/Kconfig
```kconfig
# SPDX-License-Identifier: GPL-3.0
# Copyright (c) 2025 Schubert Anselme <schubert@anselm.es>

config HELLO
  bool "Enable Hello Module"
  help
    This option enables the Hello module, which provides basic greeting
    functionalities. It is useful for demonstration and testing purposes.
    If you do not need this module, you can disable it to save resources.
```

## modules/hello/Kconfig
```kconfig
config HELLO
  bool "Enable Hello Module"
  help
    This option enables the Hello module, which provides basic greeting
    functionalities. It is useful for demonstration and testing purposes.
    If you do not need this module, you can disable it to save resources.
```

## west.yml
```yaml
# SPDX-License-Identifier: GPL-3.0
# Copyright (c) 2025 Schubert Anselme <schubert@anselm.es>

manifest:
  remotes:
    - name: anselmes
      url-base: https://github.com/anselmes

  projects:
    - name: zephyr
      remote: anselmes
      revision: main

  self: .
```
